/**
 * Neural Network Inference Template for RP2040 (Raspberry Pi Pico)
 * Generated by Neural Network Optimization Pipeline
 * 
 * This template implements a feedforward neural network with one hidden layer
 * for inference on the RP2040 microcontroller.
 */

#include <Arduino.h>
#include "{{MODEL_HEADER}}"
#include "{{TEST_DATA_HEADER}}"

// Memory for intermediate activations
float hidden_layer[MODEL_HIDDEN_SIZE];
float output_layer[MODEL_OUTPUT_SIZE];

// Timing variables
unsigned long start_time, end_time, benchmark_start_time;
float total_inference_time = 0;
float avg_inference_time = 0;
unsigned long inference_count = 0;
const unsigned long BENCHMARK_DURATION = 60000; // 1 minute in milliseconds

// Function declarations
void matrix_vector_multiply(const float* matrix, const float* vector, float* result, 
                           int matrix_rows, int matrix_cols);
void add_bias(float* vector, const float* bias, int size);
void apply_relu(float* vector, int size);
void apply_sigmoid(float* vector, int size);
float calculate_accuracy(const float* predictions, const int* true_labels, int num_samples);
void run_inference(const float* input_data, int* prediction);
void run_benchmark(unsigned long duration_ms);

void setup() {
  Serial.begin(115200);
  while (!Serial) delay(10);  // Wait for serial port to connect
  
  Serial.println();
  Serial.println("===================================================");
  Serial.println("Neural Network Inference on RP2040");
  Serial.println("===================================================");
  Serial.println("Model: {{DATASET_NAME}} ({{MODEL_TYPE}})");
  Serial.println("Input size: " + String(MODEL_INPUT_SIZE));
  Serial.println("Hidden size: " + String(MODEL_HIDDEN_SIZE));
  Serial.println("Output size: " + String(MODEL_OUTPUT_SIZE));
  Serial.println("Quantization: " + String(MODEL_QUANTIZATION_BITS) + " bits");
  Serial.println("---------------------------------------------------");
  
  // First, run inference on test samples to verify accuracy
  Serial.println("Running initial test set verification...");
  int correct_predictions = 0;
  
  for (int i = 0; i < TEST_NUM_SAMPLES; i++) {
    Serial.print("Sample ");
    Serial.print(i + 1);
    Serial.print(": ");
    
    int prediction;
    run_inference(test_samples[i], &prediction);
    
    // Check if prediction is correct
    bool is_correct = prediction == test_labels[i];
    if (is_correct) {
      correct_predictions++;
    }
    
    // Print results
    Serial.print("Prediction = ");
    Serial.print(prediction);
    Serial.print(", True label = ");
    Serial.print(test_labels[i]);
    Serial.print(", Time = ");
    Serial.print(end_time - start_time);
    Serial.print(" μs, ");
    Serial.println(is_correct ? "CORRECT" : "WRONG");
    
    // Print raw outputs
    Serial.print("  Outputs: [");
    for (int j = 0; j < MODEL_OUTPUT_SIZE; j++) {
      Serial.print(output_layer[j], 4);
      if (j < MODEL_OUTPUT_SIZE - 1) {
        Serial.print(", ");
      }
    }
    Serial.println("]");
  }
  
  float accuracy = 100.0 * correct_predictions / TEST_NUM_SAMPLES;
  Serial.print("Accuracy on test samples: ");
  Serial.print(accuracy);
  Serial.println("%");
  
  Serial.println("---------------------------------------------------");
  Serial.println("Starting 1-minute continuous inference benchmark...");
  Serial.println("---------------------------------------------------");
  
  // Run the 1-minute benchmark
  run_benchmark(BENCHMARK_DURATION);
  
  Serial.println("===================================================");
  Serial.println("Send any character to re-run the benchmark...");
}

void loop() {
  if (Serial.available()) {
    Serial.read();  // Clear the input buffer
    
    Serial.println("---------------------------------------------------");
    Serial.println("Starting 1-minute continuous inference benchmark...");
    Serial.println("---------------------------------------------------");
    
    // Reset statistics
    total_inference_time = 0;
    avg_inference_time = 0;
    inference_count = 0;
    
    // Run the benchmark again
    run_benchmark(BENCHMARK_DURATION);
    
    Serial.println("===================================================");
    Serial.println("Send any character to re-run the benchmark...");
  }
}

/**
 * Run inference on a single input sample
 */
void run_inference(const float* input_data, int* prediction) {
  // Start timing
  start_time = micros();
  
  // Forward pass
  
  // First layer: input -> hidden
  matrix_vector_multiply({{MODEL_TYPE}}_dense1_weights, input_data, hidden_layer,
                        {{MODEL_TYPE}}_dense1_shape[0], {{MODEL_TYPE}}_dense1_shape[1]);
  add_bias(hidden_layer, {{MODEL_TYPE}}_dense1_bias, MODEL_HIDDEN_SIZE);
  apply_relu(hidden_layer, MODEL_HIDDEN_SIZE);
  
  // Second layer: hidden -> output
  matrix_vector_multiply({{MODEL_TYPE}}_dense2_weights, hidden_layer, output_layer,
                        {{MODEL_TYPE}}_dense2_shape[0], {{MODEL_TYPE}}_dense2_shape[1]);
  add_bias(output_layer, {{MODEL_TYPE}}_dense2_bias, MODEL_OUTPUT_SIZE);
  
  // For binary classification, apply sigmoid
  if (MODEL_OUTPUT_SIZE == 1) {
    apply_sigmoid(output_layer, MODEL_OUTPUT_SIZE);
  }
  
  // Stop timing
  end_time = micros();
  
  // Determine prediction
  if (MODEL_OUTPUT_SIZE == 1) {
    // Binary classification
    *prediction = output_layer[0] >= 0.5 ? 1 : 0;
  } else {
    // Multi-class classification - find max
    float max_val = output_layer[0];
    *prediction = 0;
    
    for (int j = 1; j < MODEL_OUTPUT_SIZE; j++) {
      if (output_layer[j] > max_val) {
        max_val = output_layer[j];
        *prediction = j;
      }
    }
  }
}

/**
 * Run continuous inference for a specified duration
 */
void run_benchmark(unsigned long duration_ms) {
  benchmark_start_time = millis();
  unsigned long current_time;
  unsigned int sample_index = 0;
  int prediction;
  unsigned long progress_interval = duration_ms / 10; // Report progress 10 times
  unsigned long next_progress = progress_interval;
  
  // Reset statistics
  inference_count = 0;
  total_inference_time = 0;
  
  do {
    // Run inference on the next test sample
    run_inference(test_samples[sample_index], &prediction);
    
    // Update statistics
    inference_count++;
    total_inference_time += (end_time - start_time);
    
    // Rotate through test samples
    sample_index = (sample_index + 1) % TEST_NUM_SAMPLES;
    
    // Check if we should report progress
    current_time = millis() - benchmark_start_time;
    if (current_time >= next_progress) {
      int progress_percent = (current_time * 100) / duration_ms;
      Serial.print(progress_percent);
      Serial.print("% complete, ");
      Serial.print(inference_count);
      Serial.println(" inferences so far");
      next_progress += progress_interval;
    }
    
  } while (current_time < duration_ms);
  
  // Calculate and print summary statistics
  avg_inference_time = total_inference_time / inference_count;
  float inferences_per_second = 1000000.0 / avg_inference_time;
  
  Serial.println("\n===================================================");
  Serial.println("Benchmark Results:");
  Serial.println("---------------------------------------------------");
  Serial.print("Total runtime: ");
  Serial.print(current_time / 1000.0);
  Serial.println(" seconds");
  Serial.print("Total inferences: ");
  Serial.println(inference_count);
  Serial.print("Average inference time: ");
  Serial.print(avg_inference_time);
  Serial.println(" μs");
  Serial.print("Inferences per second: ");
  Serial.print(inferences_per_second);
  Serial.println(" inf/sec");
  Serial.print("Memory usage (approximate): ");
  Serial.print(MODEL_INPUT_SIZE * MODEL_HIDDEN_SIZE * 4 + MODEL_HIDDEN_SIZE * MODEL_OUTPUT_SIZE * 4 + MODEL_HIDDEN_SIZE * 4 + MODEL_OUTPUT_SIZE * 4);
  Serial.println(" bytes");
  Serial.println("===================================================");
}

/**
 * Matrix-vector multiplication: result = matrix * vector
 * Matrix is stored in row-major order (flattened)
 */
void matrix_vector_multiply(const float* matrix, const float* vector, float* result, 
                           int matrix_rows, int matrix_cols) {
  for (int i = 0; i < matrix_rows; i++) {
    result[i] = 0.0;
    for (int j = 0; j < matrix_cols; j++) {
      result[i] += matrix[i * matrix_cols + j] * vector[j];
    }
  }
}

/**
 * Add bias to a vector: vector += bias
 */
void add_bias(float* vector, const float* bias, int size) {
  for (int i = 0; i < size; i++) {
    vector[i] += bias[i];
  }
}

/**
 * Apply ReLU activation: vector = max(0, vector)
 */
void apply_relu(float* vector, int size) {
  for (int i = 0; i < size; i++) {
    if (vector[i] < 0) {
      vector[i] = 0;
    }
  }
}

/**
 * Apply sigmoid activation: vector = 1 / (1 + exp(-vector))
 */
void apply_sigmoid(float* vector, int size) {
  for (int i = 0; i < size; i++) {
    vector[i] = 1.0 / (1.0 + exp(-vector[i]));
  }
} 